## arch/arm/configs/hi3516cv608_nand_mini_defconfig
```kconfig
# CONFIG_LOCALVERSION_AUTO is not set
CONFIG_KERNEL_XZ=y
# CONFIG_SWAP is not set
CONFIG_SYSVIPC=y
# CONFIG_CROSS_MEMORY_ATTACH is not set
# CONFIG_CPU_ISOLATION is not set
CONFIG_LOG_BUF_SHIFT=12
CONFIG_LOG_CPU_MAX_BUF_SHIFT=1
CONFIG_PRINTK_SAFE_LOG_BUF_SHIFT=10
CONFIG_SYSFS_DEPRECATED=y
CONFIG_RELAY=y
CONFIG_CC_OPTIMIZE_FOR_SIZE=y
CONFIG_SGETMASK_SYSCALL=y
# CONFIG_SYSFS_SYSCALL is not set
# CONFIG_FHANDLE is not set
# CONFIG_BUG is not set
# CONFIG_BASE_FULL is not set
# CONFIG_SHMEM is not set
# CONFIG_AIO is not set
# CONFIG_IO_URING is not set
# CONFIG_ADVISE_SYSCALLS is not set
# CONFIG_MEMBARRIER is not set
# CONFIG_KALLSYMS is not set
# CONFIG_RSEQ is not set
CONFIG_EMBEDDED=y
# CONFIG_VM_EVENT_COUNTERS is not set
# CONFIG_SLUB_DEBUG is not set
CONFIG_ARCH_BSP=y
CONFIG_ARCH_HI3516CV608=y
# CONFIG_VDSO is not set
# CONFIG_CACHE_L2X0 is not set
CONFIG_SMP=y
CONFIG_NR_CPUS=2
CONFIG_THUMB2_KERNEL=y
CONFIG_CPU_SW_DOMAIN_PAN=y
# CONFIG_ARM_MODULE_PLTS is not set
CONFIG_ARM_APPENDED_DTB=y
CONFIG_ARM_ATAG_DTB_COMPAT=y
CONFIG_VFP=y
CONFIG_NEON=y
# CONFIG_SUSPEND is not set
# CONFIG_SECCOMP is not set
# CONFIG_GCC_PLUGINS is not set
CONFIG_MODULES=y
CONFIG_MODULE_UNLOAD=y
CONFIG_BLK_CMDLINE_PARSER=y
# CONFIG_MQ_IOSCHED_DEADLINE is not set
# CONFIG_MQ_IOSCHED_KYBER is not set
# CONFIG_ENABLE_IPREC_DEBUG is not set
# CONFIG_COREDUMP is not set
# CONFIG_COMPACTION is not set
CONFIG_NET=y
CONFIG_UNIX=y
CONFIG_INET=y
# CONFIG_INET_DIAG is not set
# CONFIG_IPV6 is not set
# CONFIG_WIRELESS is not set
# CONFIG_ETHTOOL_NETLINK is not set
CONFIG_UEVENT_HELPER=y
CONFIG_DEVTMPFS=y
# CONFIG_STANDALONE is not set
# CONFIG_PREVENT_FIRMWARE_BUILD is not set
# CONFIG_FW_LOADER is not set
# CONFIG_ALLOW_DEV_COREDUMP is not set
CONFIG_MTD=y
CONFIG_MTD_CMDLINE_PARTS=y
# CONFIG_MTD_OF_PARTS is not set
CONFIG_MTD_SPI_NAND_BSP=y
CONFIG_MTD_RAW_NAND=y
CONFIG_MTD_SPI_NAND_FMC100=y
CONFIG_MTD_SPI_NAND=y
CONFIG_MTD_UBI=y
# CONFIG_BLK_DEV is not set
CONFIG_NETDEVICES=y
# CONFIG_NET_CORE is not set
# CONFIG_NET_VENDOR_ALACRITECH is not set
# CONFIG_NET_VENDOR_AMAZON is not set
# CONFIG_NET_VENDOR_AQUANTIA is not set
# CONFIG_NET_VENDOR_ARC is not set
# CONFIG_NET_VENDOR_AURORA is not set
# CONFIG_NET_VENDOR_BROADCOM is not set
# CONFIG_NET_VENDOR_CADENCE is not set
# CONFIG_NET_VENDOR_CAVIUM is not set
# CONFIG_NET_VENDOR_CIRRUS is not set
# CONFIG_NET_VENDOR_CORTINA is not set
# CONFIG_NET_VENDOR_EZCHIP is not set
# CONFIG_NET_VENDOR_FARADAY is not set
# CONFIG_NET_VENDOR_GOOGLE is not set
# CONFIG_NET_VENDOR_INTEL is not set
CONFIG_VENDOR_FEMAC=y
CONFIG_MDIO_VENDOR_FEMAC=y
# CONFIG_WLAN is not set
# CONFIG_INPUT_KEYBOARD is not set
# CONFIG_INPUT_MOUSE is not set
# CONFIG_SERIO is not set
# CONFIG_LEGACY_PTYS is not set
CONFIG_SERIAL_AMBA_PL011=y
CONFIG_SERIAL_AMBA_PL011_CONSOLE=y
# CONFIG_HW_RANDOM is not set
# CONFIG_RANDOM_TRUST_BOOTLOADER is not set
CONFIG_I2C=y
# CONFIG_I2C_COMPAT is not set
CONFIG_I2C_CHARDEV=y
# CONFIG_I2C_HELPER_AUTO is not set
CONFIG_I2C_BSP=y
CONFIG_SPI=y
CONFIG_POWER_RESET_BSP=y
# CONFIG_HWMON is not set
CONFIG_MFD_BSP_FMC=y
CONFIG_MFD_SYSCON=y
# CONFIG_HID is not set
# CONFIG_USB_SUPPORT is not set
# CONFIG_VIRTIO_MENU is not set
# CONFIG_VHOST_MENU is not set
# CONFIG_ARM_ARCH_TIMER_EVTSTREAM is not set
# CONFIG_IOMMU_SUPPORT is not set
# CONFIG_NVMEM is not set
# CONFIG_DNOTIFY is not set
CONFIG_UBIFS_FS=y
# CONFIG_UBIFS_FS_XATTR is not set
CONFIG_NFS_FS=y
# CONFIG_NFS_V2 is not set
CONFIG_NLS=y
# CONFIG_CRYPTO_HW is not set
# CONFIG_SYMBOLIC_ERRNAME is not set
# CONFIG_ENABLE_MUST_CHECK is not set
# CONFIG_SECTION_MISMATCH_WARN_ONLY is not set
# CONFIG_DEBUG_MISC is not set
# CONFIG_SCHED_DEBUG is not set
# CONFIG_RCU_TRACE is not set
# CONFIG_FTRACE is not set
# CONFIG_RUNTIME_TESTING_MENU is not set
CONFIG_SECURITY_DMESG_RESTRICT=y
CONFIG_HARDENED_USERCOPY=y
CONFIG_INIT_ON_ALLOC_DEFAULT_ON=y
```

## arch/arm/configs/hi3516cv610_nor_quickboot_defconfig
```kconfig
# CONFIG_LOCALVERSION_AUTO is not set
CONFIG_KERNEL_XZ=y
# CONFIG_SWAP is not set
CONFIG_SYSVIPC=y
# CONFIG_CROSS_MEMORY_ATTACH is not set
CONFIG_HIGH_RES_TIMERS=y
CONFIG_LOG_BUF_SHIFT=14
CONFIG_SYSFS_DEPRECATED=y
CONFIG_RELAY=y
CONFIG_BLK_DEV_INITRD=y
CONFIG_CC_OPTIMIZE_FOR_SIZE=y
CONFIG_SGETMASK_SYSCALL=y
# CONFIG_SYSFS_SYSCALL is not set
# CONFIG_FHANDLE is not set
# CONFIG_BUG is not set
# CONFIG_BASE_FULL is not set
# CONFIG_SHMEM is not set
# CONFIG_AIO is not set
# CONFIG_IO_URING is not set
# CONFIG_ADVISE_SYSCALLS is not set
# CONFIG_MEMBARRIER is not set
# CONFIG_KALLSYMS is not set
# CONFIG_RSEQ is not set
CONFIG_EMBEDDED=y
# CONFIG_VM_EVENT_COUNTERS is not set
# CONFIG_SLUB_DEBUG is not set
CONFIG_ARCH_BSP=y
CONFIG_ARCH_HI3516CV610=y
CONFIG_VENDOR_RAMDISK_ZERO_COPY=y
CONFIG_VENDOR_TIMER_TRIGGER_RCU=y
# CONFIG_VDSO is not set
# CONFIG_CACHE_L2X0 is not set
CONFIG_SMP=y
CONFIG_NR_CPUS=2
CONFIG_THUMB2_KERNEL=y
CONFIG_CPU_SW_DOMAIN_PAN=y
# CONFIG_ARM_MODULE_PLTS is not set
CONFIG_ARM_APPENDED_DTB=y
CONFIG_ARM_ATAG_DTB_COMPAT=y
CONFIG_VFP=y
CONFIG_NEON=y
# CONFIG_SUSPEND is not set
# CONFIG_SECCOMP is not set
# CONFIG_STRICT_KERNEL_RWX is not set
# CONFIG_STRICT_MODULE_RWX is not set
# CONFIG_GCC_PLUGINS is not set
CONFIG_MODULES=y
CONFIG_MODULE_UNLOAD=y
CONFIG_BLK_CMDLINE_PARSER=y
# CONFIG_MQ_IOSCHED_DEADLINE is not set
# CONFIG_MQ_IOSCHED_KYBER is not set
# CONFIG_COREDUMP is not set
# CONFIG_COMPACTION is not set
CONFIG_UEVENT_HELPER=y
CONFIG_DEVTMPFS=y
CONFIG_DEVTMPFS_MOUNT=y
# CONFIG_STANDALONE is not set
# CONFIG_PREVENT_FIRMWARE_BUILD is not set
# CONFIG_FW_LOADER is not set
# CONFIG_ALLOW_DEV_COREDUMP is not set
CONFIG_MTD=y
CONFIG_MTD_CMDLINE_PARTS=y
# CONFIG_MTD_OF_PARTS is not set
CONFIG_MTD_BLOCK=y
CONFIG_MTD_SPI_NOR=y
# CONFIG_MTD_SPI_NOR_USE_4K_SECTORS is not set
CONFIG_SPI_BSP_SFC=y
# CONFIG_CLOSE_SPI_8PIN_4IO is not set
CONFIG_BLK_DEV_RAM=y
CONFIG_BLK_DEV_RAM_SIZE=65536
# CONFIG_INPUT_KEYBOARD is not set
# CONFIG_INPUT_MOUSE is not set
# CONFIG_SERIO is not set
# CONFIG_LEGACY_PTYS is not set
CONFIG_SERIAL_AMBA_PL011=y
CONFIG_SERIAL_AMBA_PL011_CONSOLE=y
# CONFIG_HW_RANDOM is not set
# CONFIG_RANDOM_TRUST_BOOTLOADER is not set
CONFIG_I2C=y
# CONFIG_I2C_COMPAT is not set
CONFIG_I2C_CHARDEV=y
# CONFIG_I2C_HELPER_AUTO is not set
CONFIG_I2C_BSP=y
CONFIG_SPI=y
CONFIG_POWER_RESET_BSP=y
# CONFIG_HWMON is not set
CONFIG_MFD_BSP_FMC=y
CONFIG_MFD_SYSCON=y
# CONFIG_HID is not set
# CONFIG_USB_SUPPORT is not set
# CONFIG_VIRTIO_MENU is not set
# CONFIG_VHOST_MENU is not set
# CONFIG_ARM_ARCH_TIMER_EVTSTREAM is not set
# CONFIG_IOMMU_SUPPORT is not set
# CONFIG_NVMEM is not set
# CONFIG_DNOTIFY is not set
CONFIG_JFFS2_FS=y
CONFIG_ROMFS_FS=y
CONFIG_NLS=y
CONFIG_PRINTK_TIME=y
CONFIG_CMD_TIMESTAMP=y
CONFIG_BSP_FAST_STARTUP=y
CONFIG_STARTUP_PARALLEL_CREATION_NODE_OPT=y
# CONFIG_STARTUP_PARALLEL_OPT is not set
CONFIG_DEPENDENCIES=y
CONFIG_DEPENDENCIES_PARALLEL=y
CONFIG_CONSOLE_LOGLEVEL_DEFAULT=8
# CONFIG_SYMBOLIC_ERRNAME is not set
# CONFIG_ENABLE_MUST_CHECK is not set
# CONFIG_SECTION_MISMATCH_WARN_ONLY is not set
# CONFIG_DEBUG_MISC is not set
# CONFIG_SCHED_DEBUG is not set
# CONFIG_RCU_TRACE is not set
# CONFIG_FTRACE is not set
# CONFIG_RUNTIME_TESTING_MENU is not set
CONFIG_SECURITY_DMESG_RESTRICT=y
CONFIG_HARDENED_USERCOPY=y
CONFIG_INIT_ON_ALLOC_DEFAULT_ON=y
```

## arch/arm/mach-vendor/Kconfig
```kconfig
if ARCH_BSP

menu "Hisilicon BSP platform type"

config BSP_ZRELADDR
	depends on ARCH_BSP
	depends on ARCH_MULTI_V7
	hex 'bsp zreladdr'
	default "0x40020000" if ARCH_HI3516CV610_FAMILY

config ARCH_HI3516CV610
	bool "Vendor hi3516cv610 platform"
	depends on ARCH_BSP
	select ARCH_HI3516CV610_FAMILY
	help
		Support for Vendor HI3516CV610 platform

config ARCH_HI3516CV608
	bool "Vendor hi3516cv608 platform"
	depends on ARCH_BSP
	select ARCH_HI3516CV610_FAMILY
	help
		Support for Vendor HI3516CV608 platform

config ARCH_HI3516CV610_FAMILY
	bool "Vendor hi3516cv610 family"
	depends on ARCH_BSP
	depends on ARCH_MULTI_V7
	select HAVE_ARM_ARCH_TIMER
	select RESET_BSP
	help
		Support for Hisilicon HI3516CV610 Soc family.


config SOC_FAMILY
	string
	default "hi3516cv610" if ARCH_HI3516CV610_FAMILY

config VENDOR_RAMDISK_ZERO_COPY
       bool "Vendor ramdisk zero copy"
       default n
       depends on ROMFS_FS && BLK_DEV_INITRD && BLK_DEV_RAM && ARCH_BSP
       help
         Select this to reduce copy ramdisk times in DDR

config VENDOR_TIMER_TRIGGER_RCU
       bool "Fast trigger rcu"
       default n
       depends on ARCH_BSP
       help
         Select this to reduce boot time when RCU takes a lot time.  If
         CONFIG_HIGH_RES_TIMERS is enabled, the RCU time consumption can
         be reduced to almost 0, but be careful to open CONFIG_HIGH_RES_TIMERS!

config HI35XXVXX_KOL
	bool "HI35XXVXX kol optimized"
	default y
	depends on ARCH_BSP && PM_SLEEP
	help
	 KOL feature customization and optimization options for the Hi35xxvxx project
endmenu

endif
```

## drivers/clk/vendor/Kconfig
```kconfig
if ARCH_BSP
config RESET_BSP
	bool "Vendor Reset Controller Driver"
	select RESET_CONTROLLER
	help
	  Build reset controller driver for Vendor device chipsets.
endif
```

## drivers/net/ethernet/vendor/Kconfig
```kconfig
#
# VENDOR device configuration
#

config NET_VENDOR_VENDOR
	bool "Vendor devices"
	default y
	depends on OF || ACPI
	depends on ARM || ARM64 || COMPILE_TEST
	help
	  If you have a network (Ethernet) card belonging to this class, say Y.

	  Note that the answer to this question doesn't directly affect the
	  kernel: saying N will just cause the configurator to skip all
	  the questions about Vendor devices. If you say Y, you will be asked
	  for your specific card in the following questions.

if NET_VENDOR_VENDOR

config VENDOR_FEMAC
	tristate "Vendor Fast Ethernet MAC device support"
	depends on HAS_IOMEM
	select PHYLIB
	select RESET_CONTROLLER
	help
	  This selects the Vendor Fast Ethernet MAC device(FEMAC).
	  The FEMAC receives and transmits data over Ethernet
	  ports at 10/100 Mbps in full-duplex or half-duplex mode.
	  The FEMAC exchanges data with the CPU, and supports
	  the energy efficient Ethernet (EEE).

source "drivers/net/ethernet/vendor/gmac/Kconfig"
endif # NET_VENDOR_VENDOR
```

## drivers/net/ethernet/vendor/eth/Kconfig
```kconfig
#
# hleth family network device configuration
#

menuconfig FEMAC
	tristate "hleth(switch fabric) family network device support"
	select PHYLIB
	help
	  This selects the hleth family network device.

if FEMAC

config HLETH_MAX_RX_POOLS
	int "hleth max rx pool size"
	default "1024"
	help
	  hleth max static rx pool size.

endif
```

## drivers/vendor/Kconfig
```kconfig
menu "Vendor driver support"

source "drivers/vendor/cma/Kconfig"
source "drivers/vendor/usb/Kconfig"
source "drivers/vendor/ups_phy/Kconfig"
source "drivers/vendor/basedrv_clk/Kconfig"
source "drivers/vendor/mmc/Kconfig"
source "drivers/vendor/bsp_timer/Kconfig"

endmenu
```

## drivers/vendor/bsp_timer/Kconfig
```kconfig
config BSP_TIMER
	bool "Support bsp timer as wakeup source"
	default no
	depends on PM
	help
	  Support bsp timer as wakeup source
```

## init/Kconfig.faststartup
```kconfig
config BSP_FAST_STARTUP
	bool "for fast startup usage"
	select MINI_OPT
	depends on ARCH_BSP

if BSP_FAST_STARTUP
config STARTUP_PARALLEL_CREATION_NODE_OPT
	bool "parallize node creation"
config STARTUP_PARALLEL_OPT
	bool "parallize init module"
	if STARTUP_PARALLEL_OPT
	config DEPENDENCIES
		bool "Use dependency based initialization sequence (DO NOT USE)"
		select ANNOTATED_INITCALLS
		depends on STARTUP_PARALLEL_OPT
		help
		  This will likely crash your kernel at startup. You have been warned.
		  That means you should make sure you have a working backup kernel
		  you can boot from in case the kernel with this feature turned on
		  crashes.
		  In order to benefit from this feature, statically linked drivers
		  have to provide dependencies.
	config DEPENDENCIES_PARALLEL
		bool "Call annotated initcalls in parallel"
		depends on DEPENDENCIES
		help
		  Calculates which (annotated) initcalls can be called in parallel
		  and calls them using multiple threads.
	config DEPENDENCIES_THREADS
		int "Number of threads to use for parallel initialization"
		depends on DEPENDENCIES_PARALLEL
		default 0
		help
		  0 means the number of threads used for parallel initialization
		  of drivers equals the number of online CPUs.
		  1 means the threaded initialization is disabled.
	endif
endif

config MINI_OPT
	bool "for miniaturization optimize usage"

if MINI_OPT
config SYSFS_MINI_OPT
	bool "sysfs file creation optimization"
	default y
	help
	  Optimize sysfs file node creation, only disabling those unnecessary 
	  for function or debugging features.
config KUEVENT_MINI_OPT
	bool "kuevent diabled before finshing boot"
	default y
	help
	  Optimize uevent notification, only keep those required by the scenario,
	  such as the SD card, USB block subsystem device insertion and removal..
config BOOTSTAGE_PRINTK_MINI_OPT
	bool "diable log to mem"
	default y
	help
	  Generally, printk can be configured based on the priority to disable serial port output.
	  However, it still prints to the memory, which still consumes  memory and performance.
	  Therefore, performance and memory can be optimized by completely disabling printing.
config SYSFS_SLAB_MINI_OPT
	bool "sysfs slab debug disable control"
	default y
	help
	  The sysfs saves the slab allocation information to facilitate debugging.
	  In the optimized fastboot version, the function can be disabled and enabled as required.
endif
```

## kernel/Kconfig.freezer
```kconfig
# SPDX-License-Identifier: GPL-2.0-only
config FREEZER
	def_bool PM_SLEEP || CGROUP_FREEZER

if ARCH_BSP
config ENABLE_IPREC_DEBUG
	bool "Enable iprec debug"
	default y
	help
	  This is used for iprec debug printing.
endif
```
